## labs/lab01_insecure_vs_hardened/firmware/main/Kconfig.projbuild
```kconfig
menu "Secure IoT LAB 01"

choice LAB01_SECURITY_PROFILE
    prompt "Active security profile"
    default LAB01_PROFILE_INSECURE
    help
        Select the active profile for the LAB 01 firmware.
        INSECURE intentionally exposes controlled vulnerabilities for training.
        HARDENED applies the mitigations required to close LAB 01.

config LAB01_PROFILE_INSECURE
    bool "INSECURE - vulnerable training profile"

config LAB01_PROFILE_HARDENED
    bool "HARDENED - mitigated training profile"

endchoice

config LAB01_CONSOLE_LINE_MAX
    int "Maximum console command line length"
    default 160
    range 32 512
    help
        Maximum accepted command line length. Longer lines are drained and rejected.

endmenu
```

## labs/lab02_device_identity/firmware/main/Kconfig.projbuild
```kconfig
menu "Secure IoT LAB 02"

    choice LAB02_ACTIVE_PROFILE
        prompt "Active identity profile"
        default LAB02_PROFILE_INSECURE
        help
            Selects whether the lab demonstrates the intentionally vulnerable
            identity model or the hardened identity model.

        config LAB02_PROFILE_INSECURE
            bool "INSECURE - intentionally cloneable training profile"

        config LAB02_PROFILE_HARDENED
            bool "HARDENED - derived non-secret identity training profile"
    endchoice

    config LAB02_CONSOLE_LINE_MAX
        int "Maximum console line length"
        range 32 256
        default 128

endmenu
```

## labs/lab02_device_identity/firmware/sdkconfig.defaults
```kconfig
CONFIG_ESP_CONSOLE_NONE=y
CONFIG_ESP_CONSOLE_USB_SERIAL_JTAG=y
CONFIG_ESP_CONSOLE_USB_SERIAL_JTAG_ENABLED=y
CONFIG_COMPILER_CXX_EXCEPTIONS=n
CONFIG_COMPILER_CXX_RTTI=n
CONFIG_COMPILER_WARN_WRITE_STRINGS=y
CONFIG_COMPILER_OPTIMIZATION_SIZE=y
```
